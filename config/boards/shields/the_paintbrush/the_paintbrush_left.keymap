/*
 * Copyright (c) 2021 Mike "KemoNine" Crosson
 *
 * SPDX-License-Identifier: MIT
 */

#include <behaviors.dtsi>
#include <dt-bindings/zmk/keys.h>
#include <dt-bindings/zmk/bt.h>
#include <dt-bindings/zmk/ext_power.h>

// Left/Right
#define ARTSEY_LEFT 1

// ARTS Row
#define KEY_A 3
#define KEY_R 2
#define KEY_T 1
#define KEY_S 0
// EYIO Row
#define KEY_E 7
#define KEY_Y 6
#define KEY_I 5
#define KEY_O 4

//Copied from the base file for reference only
#define LAYER_ID_GLOBAL -1
#define LAYER_ID_BASE 0
#define LAYER_ID_NUMBERS 1
#define LAYER_ID_SYMBOLS 2
#define LAYER_ID_PARENTHETICALS 3
#define LAYER_ID_NAVIGATION 4
#define LAYER_ID_BT_SEL 5
#define LAYER_ID_CUSTOM 6
#define LAYER_ID_BIG_SYM 7
#define LAYER_ID_BIG_FUNCTION 8

// Define Offsets
#define LEADING_NONES NONE(0,0,0)
#define MIDDLE_NONES NONE(0, 0, 0)
#define TRAILING_NONES NONE(0, 0, 0)

#define GLOBAL_COMBO_LAYER_FILTER 0 1 2 3 4 5 7 8

#define TIMEOUT_COMBO_CUSTOM_LAYER 50

#define ARTSEY_LAYER_CUSTOM                                             \
    custom {                                                            \
			label = "Custom";                                           \
			bindings = <                                                \
                &kp LSHIFT   &kp Q  &kp W   &kp E                       \
				&kp SPACE    &kp A  &kp S   &kp D                       \
                >;                                                      \
		};

#define CUSTOM_COMBOS \
    custom_combo_4_1    { layers = <LAYER_ID_CUSTOM>; timeout-ms = <TIMEOUT_COMBO_CUSTOM_LAYER>; key-positions = <KEY_A KEY_T KEY_S KEY_O>; bindings = <&ext_power EP_ON>;  }; \
    custom_combo_4_2    { layers = <LAYER_ID_CUSTOM>; timeout-ms = <TIMEOUT_COMBO_CUSTOM_LAYER>; key-positions = <KEY_E KEY_Y KEY_I KEY_O>; bindings = <&kp SPACE>;  }; \
    custom_combo_3_1    { layers = <LAYER_ID_CUSTOM>; timeout-ms = <TIMEOUT_COMBO_CUSTOM_LAYER>; key-positions = <KEY_A KEY_T KEY_S>;       bindings = <&kp TAB>;    }; \
    custom_combo_3_2    { layers = <LAYER_ID_CUSTOM>; timeout-ms = <TIMEOUT_COMBO_CUSTOM_LAYER>; key-positions = <KEY_A KEY_T KEY_O>;       bindings = <&kp LCTRL>;  }; \
    custom_combo_3_3    { layers = <LAYER_ID_CUSTOM>; timeout-ms = <TIMEOUT_COMBO_CUSTOM_LAYER>; key-positions = <KEY_T KEY_S KEY_O>;       bindings = <&kp LALT>;   }; \
    custom_combo_2_1    { layers = <LAYER_ID_CUSTOM>; timeout-ms = <TIMEOUT_COMBO_CUSTOM_LAYER>; key-positions = <KEY_A KEY_T>;             bindings = <&kp R>;      }; \
    custom_combo_2_2    { layers = <LAYER_ID_CUSTOM>; timeout-ms = <TIMEOUT_COMBO_CUSTOM_LAYER>; key-positions = <KEY_A KEY_S>;             bindings = <&kp V>;      }; \
    custom_combo_2_3    { layers = <LAYER_ID_CUSTOM>; timeout-ms = <TIMEOUT_COMBO_CUSTOM_LAYER>; key-positions = <KEY_A KEY_O>;             bindings = <&kp F>;      }; \
    custom_combo_2_4    { layers = <LAYER_ID_CUSTOM>; timeout-ms = <TIMEOUT_COMBO_CUSTOM_LAYER>; key-positions = <KEY_T KEY_S>;             bindings = <&kp G>;      }; \
    custom_combo_2_5    { layers = <LAYER_ID_CUSTOM>; timeout-ms = <TIMEOUT_COMBO_CUSTOM_LAYER>; key-positions = <KEY_T KEY_O>;             bindings = <&kp C>;      };

// Include main artsey.io keymap
#include "../../../artsey.dtsi"

